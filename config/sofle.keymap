/*
 * SPDX-License-Identifier: MIT
 */

#include <behaviors.dtsi>
#include <dt-bindings/zmk/keys.h>
#include <dt-bindings/zmk/bt.h>
#include <dt-bindings/zmk/rgb.h>
#include <dt-bindings/zmk/ext_power.h>

#define BASE   0
#define LOWER  1
#define RAISE  2
#define ADJUST 3

/ {

    // Conditional layers (raise+lower → adjust)
    conditional_layers {
        compatible = "zmk,conditional-layers";
        adjust_layer {
            if-layers = <LOWER RAISE>;
            then-layer = <ADJUST>;
        };
    };

    keymap {
        compatible = "zmk,keymap";

        behaviors:
            /* Убираем энкодер */
            - &sensor_joystick_x  joystick_x
            - &sensor_joystick_y  joystick_y;

        default_layer {
            bindings = <
                &kp GRAVE &kp N1 &kp N2 &kp N3 &kp N4 &kp N5              &kp N6 &kp N7 &kp N8 &kp N9 &kp N0 &none
                &kp ESC   &kp Q  &kp W  &kp E  &kp R  &kp T               &kp Y  &kp U  &kp I  &kp O  &kp P  &kp BSPC
                &kp TAB   &kp A  &kp S  &kp D  &kp F  &kp G               &kp H  &kp J  &kp K  &kp L  &kp SEMI &kp SQT
                &kp LSHFT &kp Z  &kp X  &kp C  &kp V  &kp B  &kp C_MUTE &none &kp N  &kp M  &kp COMMA &kp DOT &kp FSLH &kp RSHFT
                         &kp LGUI &kp LALT &kp LCTRL &mo LOWER &kp RET &kp SPACE &mo RAISE &kp RCTRL &kp RALT &kp RGUI
            >;

            /* На сенсоры больше не вешаем громкость/страницы */
            sensor-bindings = <&sensor_joystick_x &sensor_joystick_y>;
        };

        lower_layer {
            bindings = <
                &trans    &kp F1    &kp F2    &kp F3    &kp F4    &kp F5          &kp F6 &kp F7   &kp F8         &kp F9 &kp F10 &kp F11
                &kp GRAVE &kp N1   &kp N2   &kp N3   &kp N4   &kp N5          &kp N6 &kp N7   &kp N8         &kp N9 &kp N0  &kp F12
                &trans    &kp EXCL &kp AT   &kp HASH &kp DLLR &kp PRCNT       &kp CARET &kp AMPS &kp KP_MULTIPLY &kp LPAR &kp RPAR &kp PIPE
                &trans    &kp EQUAL &kp MINUS &kp KP_PLUS &kp LBRC &kp RBRC &trans &trans &kp LBKT &kp RBKT &kp SEMI &kp COLON &kp BSLH &trans
                          &trans   &trans   &trans   &trans   &trans &trans   &trans &trans &trans   &trans &trans
            >;
            sensor-bindings = <&sensor_joystick_x &sensor_joystick_y>;
        };

        raise_layer {
            bindings = <
                &bt BT_CLR &bt BT_SEL 0 &bt BT_SEL 1 &bt BT_SEL 2 &bt BT_SEL 3 &bt BT_SEL 4  &trans &trans &trans &trans &trans &trans
                &trans     &kp INS      &kp PSCRN    &kp K_CMENU  &trans       &trans      &kp PG_UP &trans &kp UP   &trans &kp N0 &trans
                &trans     &kp LALT     &kp LCTRL    &kp LSHFT    &trans       &kp CLCK     &kp PG_DN &kp LEFT &kp DOWN &kp RIGHT &kp DEL &kp BSPC
                &trans     &kp K_UNDO   &kp K_CUT    &kp K_COPY   &kp K_PASTE  &trans &trans   &trans &trans &trans &trans &trans &trans
                          &trans   &trans   &trans   &trans   &trans &trans   &trans &trans &trans   &trans
            >;
            sensor-bindings = <&sensor_joystick_x &sensor_joystick_y>;
        };

        adjust_layer {
            bindings = <
                &bt BT_CLR                      &bt BT_SEL 0    &bt BT_SEL 1    &bt BT_SEL 2    &bt BT_SEL 3    &bt BT_SEL 4    &none &none &none &none &none &none
                &ext_power EXT_POWER_TOGGLE_CMD &rgb_ug RGB_HUD &rgb_ug RGB_HUI &rgb_ug RGB_SAD &rgb_ug RGB_SAI &rgb_ug RGB_EFF &none &none &none &none &none &none
                &none                           &rgb_ug RGB_BRD &rgb_ug RGB_BRI &none           &none           &none           &none &none &none &none &none &none
                &none                           &none           &none           &none           &none           &none           &rgb_ug RGB_TOG &none &none &none &none &none &none
                              &none           &none           &none           &none           &none           &none           &none &none &none &none
            >;
        };
    };
};

/*
 * DTC-фрагмент: два аналоговых сенсора-оси вместо энкодера
 */
dts:
  fragment@0 {
    target-path = "/";
    __overlay__ {
      &adc1 { status = "okay"; };
      &adc2 { status = "okay"; };

      sensors {
        /* Ось X: ◀ → */
        joystick_x: sensor_joystick_x {
          compatible = "zmk,behavior-sensor-rotate-var";
          label = "Joystick X";
          zephyr,sensor = <&adc1 0>;
          #binding-cells = <2>;
          rotate-ccw = <&mkp MOVE_LEFT>;
          rotate-cw  = <&mkp MOVE_RIGHT>;
        };

        /* Ось Y: ▼ ▲ */
        joystick_y: sensor_joystick_y {
          compatible = "zmk,behavior-sensor-rotate-var";
          label = "Joystick Y";
          zephyr,sensor = <&adc2 0>;
          #binding-cells = <2>;
          rotate-ccw = <&mkp MOVE_DOWN>;
          rotate-cw  = <&mkp MOVE_UP>;
        };
      };

      /* Замените номера GPIO на свои реальные пины ADC */
      &sensor_joystick_x { gpios = <&gpio0 2 GPIO_INPUT>; };
      &sensor_joystick_y { gpios = <&gpio0 3 GPIO_INPUT>; };
    };
  };
